## airgapped-br2/Config.in
```kconfig
menu "Key ceremony packages"
	source "$BR2_EXTERNAL_KEYCEREMONY_PATH/package/yubico-piv-tool/Config.in"
	source "$BR2_EXTERNAL_KEYCEREMONY_PATH/package/python-pyscard/Config.in"
	source "$BR2_EXTERNAL_KEYCEREMONY_PATH/package/python-fido2/Config.in"
	source "$BR2_EXTERNAL_KEYCEREMONY_PATH/package/python-yubikey-manager/Config.in"
endmenu
```

## airgapped-br2/configs/key_ceremony_x86_64_defconfig
```kconfig
BR2_x86_64=y
BR2_PACKAGE_HOST_LINUX_HEADERS_CUSTOM_6_12=y
BR2_TOOLCHAIN_BUILDROOT_GLIBC=y
BR2_TOOLCHAIN_BUILDROOT_CXX=y
BR2_TOOLCHAIN_BUILDROOT_WCHAR=y
BR2_TOOLCHAIN_BUILDROOT_LOCALE=y
BR2_INSTALL_LIBSTDCPP=y
BR2_ROOTFS_DEVICE_CREATION_DYNAMIC_EUDEV=y
BR2_TARGET_GENERIC_HOSTNAME="key-ceremony"
BR2_TARGET_GENERIC_ISSUE="Welcome to the key ceremony environment."
BR2_TARGET_GENERIC_GETTY=y
BR2_TARGET_GENERIC_GETTY_PORT="tty1"
BR2_TARGET_GENERIC_GETTY_BAUDRATE_115200=y
BR2_TARGET_GENERIC_GETTY_TERM="linux"
BR2_TARGET_GENERIC_ROOT_PASSWD=""
BR2_SYSTEM_BIN_SH_BASH=y
BR2_ENABLE_LOCALE_PURGE=y
BR2_ENABLE_LOCALE_WHITELIST="en_US"
BR2_GENERATE_LOCALE="en_US.UTF-8"
BR2_SYSTEM_ENABLE_NLS=y
BR2_LINUX_KERNEL=y
BR2_LINUX_KERNEL_CUSTOM_VERSION=y
BR2_LINUX_KERNEL_CUSTOM_VERSION_VALUE="6.12.47"
BR2_LINUX_KERNEL_USE_DEFCONFIG=y
BR2_LINUX_KERNEL_DEFCONFIG="x86_64"
BR2_LINUX_KERNEL_CONFIG_FRAGMENT_FILES="$(BR2_EXTERNAL_KEYCEREMONY_PATH)/board/keyceremony/linux.fragment"
BR2_LINUX_KERNEL_NEEDS_HOST_OPENSSL=y
BR2_LINUX_KERNEL_NEEDS_HOST_LIBELF=y
BR2_PACKAGE_BUSYBOX_SHOW_OTHERS=y
BR2_PACKAGE_EUDEV=y
BR2_PACKAGE_OPENSSL=y
BR2_PACKAGE_PCSC_LITE=y
BR2_PACKAGE_CCID=y
BR2_PACKAGE_USBUTILS=y
BR2_PACKAGE_PCSC_TOOLS=y
BR2_PACKAGE_VIM=y
BR2_PACKAGE_YUBICO_PIV_TOOL=y
BR2_PACKAGE_PYTHON3=y
BR2_TARGET_ROOTFS_INITRAMFS=y
BR2_TARGET_ROOTFS_INITRAMFS_COMPRESSION_GZIP=y
BR2_TARGET_ROOTFS_ISO9660=y
BR2_TARGET_ROOTFS_ISO9660_GRUB2=y
BR2_TARGET_ROOTFS_ISO9660_INITRD=y
BR2_TARGET_ROOTFS_ISO9660_BOOT_MENU="$(BR2_EXTERNAL_KEYCEREMONY_PATH)/board/keyceremony/grub.cfg"
BR2_TARGET_GRUB2=y
BR2_TARGET_GRUB2_I386_PC=y
BR2_TARGET_GRUB2_X86_64_EFI=y
BR2_TARGET_GRUB2_BOOT_PARTITION="cd"
BR2_TARGET_GRUB2_BUILTIN_MODULES_PC="biosdisk iso9660 part_msdos part_gpt normal configfile search search_fs_file search_fs_uuid linux"
BR2_TARGET_GRUB2_BUILTIN_CONFIG_PC="$(BR2_EXTERNAL_KEYCEREMONY_PATH)/board/keyceremony/grub-embed.cfg"
BR2_TARGET_GRUB2_BUILTIN_MODULES_EFI="boot linux iso9660 part_msdos part_gpt normal configfile efi_gop search search_fs_file search_fs_uuid"
BR2_TARGET_GRUB2_BUILTIN_CONFIG_EFI="$(BR2_EXTERNAL_KEYCEREMONY_PATH)/board/keyceremony/grub-embed.cfg"
BR2_ROOTFS_OVERLAY="$(BR2_EXTERNAL_KEYCEREMONY_PATH)/board/keyceremony/rootfs-overlay"
BR2_ROOTFS_POST_BUILD_SCRIPT="$(BR2_EXTERNAL_KEYCEREMONY_PATH)/board/keyceremony/post-build.sh"
BR2_PACKAGE_HOST_DOSFSTOOLS=y
BR2_PACKAGE_HOST_GENIMAGE=y
BR2_PACKAGE_HOST_MTOOLS=y
BR2_PACKAGE_HOST_XORRISO=y
```

## airgapped-br2/package/python-fido2/Config.in
```kconfig
config BR2_PACKAGE_PYTHON_FIDO2
	bool "python-fido2"
	select BR2_PACKAGE_PYTHON_CRYPTOGRAPHY # runtime
	help
	  FIDO2/WebAuthn library for implementing clients and
	  servers.

	  https://github.com/Yubico/python-fido2
```

## airgapped-br2/package/python-pyscard/Config.in
```kconfig
config BR2_PACKAGE_PYTHON_PYSCARD
	bool "python-pyscard"
	select BR2_PACKAGE_PYTHON_TYPING_EXTENSIONS # runtime
	help
	  Smartcard module for Python.

	  https://github.com/LudovicRousseau/pyscard
```

## airgapped-br2/package/python-yubikey-manager/Config.in
```kconfig
config BR2_PACKAGE_PYTHON_YUBIKEY_MANAGER
	bool "python-yubikey-manager"
	select BR2_PACKAGE_PYTHON_CLICK # runtime
	select BR2_PACKAGE_PYTHON_CRYPTOGRAPHY # runtime
	select BR2_PACKAGE_PYTHON_FIDO2 # runtime
	select BR2_PACKAGE_PYTHON_KEYRING # runtime
	select BR2_PACKAGE_PYTHON_PYSCARD # runtime
	select BR2_PACKAGE_PYTHON_PYWIN32 # runtime
	help
	  Library and CLI for managing your YubiKey configuration.

	  https://github.com/Yubico/yubikey-manager
```

## airgapped-br2/package/yubico-piv-tool/Config.in
```kconfig
config BR2_PACKAGE_YUBICO_PIV_TOOL
	bool "yubico-piv-tool"
	depends on BR2_TOOLCHAIN_HAS_THREADS # pcsc-lite
	depends on BR2_USE_MMU # pcsc-lite
	depends on !BR2_STATIC_LIBS # shared libykpiv
	depends on BR2_INSTALL_LIBSTDCPP # needs C++
	depends on BR2_TOOLCHAIN_GCC_AT_LEAST_4_9 # pcsc-lite requirement
	select BR2_PACKAGE_OPENSSL
	select BR2_PACKAGE_PCSC_LITE
	select BR2_PACKAGE_CHECK
	select BR2_PACKAGE_ZLIB
	help
	  Yubico PIV Tool provides the ykpiv library, PKCS#11 module,
	  and command-line utilities for managing the Personal Identity
	  Verification (PIV) applet on YubiKey hardware tokens.

	  https://developers.yubico.com/yubico-piv-tool/

comment "yubico-piv-tool needs a toolchain w/ threads, dynamic library, C++, gcc >= 4.9"
	depends on BR2_USE_MMU
	depends on !BR2_TOOLCHAIN_HAS_THREADS || BR2_STATIC_LIBS || \
		!BR2_TOOLCHAIN_GCC_AT_LEAST_4_9 || \
		!BR2_INSTALL_LIBSTDCPP
```
